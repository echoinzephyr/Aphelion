## main/Kconfig.projbuild
```kconfig
menu "Aphelion hardware"

    config APHELION_TOOLBOX
        bool "Build the headless toolbox firmware"
        default n

    config APHELION_TOOLBOX_DISPLAY
        bool "Enable the optional OLED and sensors in the toolbox"
        depends on APHELION_TOOLBOX
        default y

    choice APHELION_OLED_MODEL
        prompt "I2C OLED controller and size"
        depends on !APHELION_TOOLBOX || APHELION_TOOLBOX_DISPLAY
        default APHELION_OLED_SSD1306_64

        config APHELION_OLED_SSD1306_64
            bool "SSD1306 128x64"

        config APHELION_OLED_SSD1306_32
            bool "SSD1306 128x32"

        config APHELION_OLED_SH1106
            bool "SH1106 128x64"
    endchoice

endmenu
```

## sdkconfig.defaults
```kconfig
CONFIG_APHELION_OLED_SH1106=y
CONFIG_PARTITION_TABLE_SINGLE_APP_LARGE=y
CONFIG_LV_FONT_MONTSERRAT_12=y
CONFIG_LV_FONT_UNSCII_8=y
CONFIG_LV_MEM_SIZE_KILOBYTES=32
CONFIG_LV_USE_THEME_DEFAULT=n
CONFIG_LV_USE_THEME_SIMPLE=n
CONFIG_LV_BUILD_EXAMPLES=n
CONFIG_LWIP_SNTP_MAX_SERVERS=2
CONFIG_LV_FONT_MONTSERRAT_20=y
CONFIG_CJSON_NESTING_LIMIT=8
```
